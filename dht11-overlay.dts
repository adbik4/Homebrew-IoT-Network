/dts-v1/;
/plugin/;

/ {
    compatible = "brcm,bcm2835";
    fragment@0 {
        target-path = "/";
        __overlay__ {
            dht11 {
                compatible = "dht11";
                gpios = <&gpio 6 0>;
                status = "okay";
            };
        };
    };
};
